## Documentation/devicetree/bindings/watchdog/mtk-wdt.txt
```
Mediatek SoCs Watchdog timer

Required properties:

- compatible should contain:
	* "mediatek,mt2701-wdt" for MT2701 compatible watchdog timers
	* "mediatek,mt6589-wdt" for all compatible watchdog timers (MT2701,
		MT6589)

- reg : Specifies base physical address and size of the registers.

Optional properties:
- timeout-sec: contains the watchdog timeout in seconds.

Example:

wdt: watchdog@10000000 {
	compatible = "mediatek,mt6589-wdt";
	reg = <0x10000000 0x18>;
	timeout-sec = <10>;
};
```

## arch/arm/mach-airoha/Kconfig
```kconfig
config ARCH_AIROHA
	bool "Airoha SoC Family"
	select ARM_GIC
	select ARM_GIC_V3
	select ARM_AMBA
	select HAVE_ALIGNED_STRUCT_PAGE
	select HAVE_DEBUG_BUGVERBOSE
	select HAVE_ARM_ARCH_TIMER
	help
	  This enables support for Airoha AN75xx ARMv8 SoCs

if ARCH_AIROHA

config MACH_AN7552
	bool "Airoha AN7552 series SoC support"

endif
```

## arch/mips/rt2880/Kconfig
```kconfig
if RALINK_MT7621

choice
	prompt "Soc Hardware Type"
	default MT7621_ASIC

config  MT7621_ASIC
	bool "MT7621-ASIC"
endchoice

config PCIE_PORT0
	bool "PCIe Port0 support"
	default y

config PCIE_PORT1
	bool "PCIe Port1 support"
	default n

config PCIE_PORT2
	bool "PCIe Port2 support"
	default n

config PCIE_PERST_ONLY
	bool "Use single PERST_N pin (GPIO19) to reset PCIe peripherals"
	default y
endif

#--------------------------

if RALINK_MT7628

choice
	prompt "Soc Hardware Type"
	default MT7628_ASIC

config  MT7628_ASIC
	bool "MT7628/MT7688-ASIC"
endchoice

endif

#--------------------------

config  CLKSRC_MIPS_GIC
	bool "Use MIPS GIC Counter (64 bit)"
	depends on MIPS_GIC
	default n

#--------------------------

choice
	prompt "DRAM Size"
	default RT2880_DRAM_64M

config RT2880_DRAM_16M
	bool "16M"

config RT2880_DRAM_32M
	bool "32M"

config RT2880_DRAM_64M
	bool "64M"

config RT2880_DRAM_128M
	bool "128M"

config RT2880_DRAM_256M
	bool "256M"

config RT2880_DRAM_512M
	bool "512M (448M + 64M Highmem)"
	depends on RALINK_MT7621
	select LONG_CALLS

endchoice

config RALINK_RAM_SIZE
	int
	default 16 if RT2880_DRAM_16M
	default 32 if RT2880_DRAM_32M
	default 64 if RT2880_DRAM_64M
	default 128 if RT2880_DRAM_128M
	default 256 if RT2880_DRAM_256M
	default 512 if RT2880_DRAM_512M

#--------------------------

if MTD
source "drivers/mtd/ralink/Kconfig"
endif

#--------------------------

choice
	prompt "UART Baud Rate"
	default RT2880_UART_57600

config RT2880_UART_57600
	bool "57600"

config RT2880_UART_115200
	bool "115200"

endchoice

config  RALINK_UART_BRATE
	int
	default 57600 if RT2880_UART_57600
	default 115200 if RT2880_UART_115200

#--------------------------

config  RALINK_TIMER_DFS
	tristate "Ralink DFS Timer"
	default n

config  RALINK_TIMER_WDG
	tristate "Ralink WatchDog Timer"
	default n

config  RALINK_TIMER_WDG_RESET_OUTPUT
	bool "Ralink WatchDog Reset Output GPIO Pin"
	depends on RALINK_TIMER_WDG
	default n

config  RALINK_TIMER_WDG_REBOOT_DELAY
	int "WatchDog Timer Reboot Delay (Unit:1Sec, Max=30Sec)"
	default 15
	depends on RALINK_TIMER_WDG

config  RALINK_TIMER_WDG_REFRESH_INTERVAL
	int "WatchDog Refresh Interval (Unit:1Sec, Max=30Sec)"
	default 4
	depends on RALINK_TIMER_WDG
```

## arch/mips/tc3262/Kconfig
```kconfig
if MIPS_TC3262

config PCIE_PORT1
	bool "Second PCIe port support"
	default n

#--------------------------

if (ECONET_EN7512 || ECONET_EN7516)

config TC3162_ADSL
	bool "Enable ADSL support"
	default n

config RALINK_VDSL
	bool "Enable VDSL support"
	default n

endif

#--------------------------

if !MIPS_TC3262_1004K

config TC3262_IMEM
	bool "Enable SPRAM IMEM"
	default y

endif

config TC3262_CPU_TIMER
	bool "Use CPU External Timer (per-VPE)"
	default y

choice
	prompt "HWFQ flat buffer allocation mode"
	default TC3262_HWFQ_ALLOC

	config TC3262_HWFQ_ALLOC
		bool "Use dma_alloc_coherent (fragmentation issue)"
	config TC3262_HWFQ_MAP_4M
		bool "Map 4MB beyond RAM size"
	config TC3262_HWFQ_MAP_8M
		bool "Map 8MB beyond RAM size"
	config TC3262_HWFQ_MAP_16M
		bool "Map 16MB beyond RAM size"
endchoice

endif # MIPS_TC3262
```

## drivers/clk/mediatek/Kconfig
```kconfig
#
# MediaTek SoC drivers
#
config COMMON_CLK_MEDIATEK
	bool
	---help---
	  Mediatek SoCs' clock support.

config COMMON_CLK_MT2701
	bool "Clock driver for Mediatek MT2701"
	depends on ARCH_MEDIATEK || COMPILE_TEST
	select COMMON_CLK_MEDIATEK
	default ARCH_MEDIATEK
	---help---
	  This driver supports Mediatek MT2701 clocks.

config COMMON_CLK_MT7622
	bool "Clock driver for Mediatek MT7622"
	depends on MACH_MT7622 || COMPILE_TEST
	select COMMON_CLK_MEDIATEK
	default MACH_MT7622
	---help---
	  This driver supports Mediatek MT7622 clocks.

config COMMON_CLK_MT7981
	bool "Clock driver for MediaTek MT7981"
	depends on MACH_MT7981 || COMPILE_TEST
	select COMMON_CLK_MEDIATEK
	default MACH_MT7981
	---help---
	  This driver supports MediaTek MT7981 basic clocks and clocks
	  required for various periperals found on MediaTek.

config COMMON_CLK_MT7986
	bool "Clock driver for MediaTek MT7986"
	depends on MACH_MT7986 || COMPILE_TEST
	select COMMON_CLK_MEDIATEK
	default MACH_MT7986
	---help---
	  This driver supports MediaTek MT7986 basic clocks and clocks
	  required for various periperals found on MediaTek.

config COMMON_CLK_MT7988
	bool "Clock driver for MediaTek MT7988"
	depends on MACH_MT7988 || COMPILE_TEST
	select COMMON_CLK_MEDIATEK
	default MACH_MT7988
	---help---
	  This driver supports MediaTek MT7988 basic clocks and clocks
	  required for various periperals found on MediaTek.

config COMMON_CLK_MT8135
	bool "Clock driver for Mediatek MT8135"
	depends on ARCH_MEDIATEK || COMPILE_TEST
	select COMMON_CLK_MEDIATEK
	default ARCH_MEDIATEK
	---help---
	  This driver supports Mediatek MT8135 clocks.

config COMMON_CLK_MT8173
	bool "Clock driver for Mediatek MT8173"
	depends on ARCH_MEDIATEK || COMPILE_TEST
	select COMMON_CLK_MEDIATEK
	default ARCH_MEDIATEK
	---help---
	  This driver supports Mediatek MT8173 clocks.
```

## drivers/misc/mediatek/Kconfig
```kconfig
if ARCH_MEDIATEK

menu "Mediatek Peripherals "

source "drivers/misc/mediatek/ice_debug/Kconfig"
source "drivers/misc/mediatek/cirq/Kconfig"
source "drivers/misc/mediatek/emi/Kconfig"
source "drivers/misc/mediatek/base/Kconfig"
source "drivers/misc/mediatek/thermal/Kconfig"
source "drivers/misc/mediatek/irrx/Kconfig"

source "drivers/misc/mediatek/btif/Kconfig"
source "drivers/misc/mediatek/btmtk_btif/Kconfig"
endmenu

endif
```

## drivers/mtd/airoha-bmt/Kconfig
```kconfig
config AIROHA_BMT
	bool "Enable MTD based NAND BMT management"
	depends on ARCH_AIROHA
	depends on MTD
	default y
```

## drivers/mtd/ralink/Kconfig
```kconfig
menu "Ralink MTD support"

config MTD_RALINK
	bool "Ralink MTD support"
	default y
	depends on MTD

if MTD_RALINK

choice
	prompt "Flash Type"
	default MTD_SPI_RALINK

	config MTD_SPI_RALINK
		bool "SPI NOR Flash"

	config MTD_NAND_MT7621
		bool "NAND Flash"
		depends on RALINK_MT7621
		select MTD_NAND
		select MTD_NAND_IDS
		select MTD_NAND_ECC
endchoice

config MTD_SPI_FAST_CLOCK
	bool "Use SPI fast clock, up to 50MHz"
	default n
	depends on MTD_SPI_RALINK

choice
	prompt "SPI Read Mode"
	default MTD_SPI_READ_NORM
	depends on MTD_SPI_RALINK

	config MTD_SPI_READ_NORM
		bool "Normal Read, opcode 0x03"
	config MTD_SPI_READ_FAST
		bool "Fast Read, opcode 0x0B"
endchoice

choice
	prompt "Flash Size"
	default RT2880_FLASH_AUTO

	config RT2880_FLASH_8M
		bool "8M"
		depends on MTD_SPI_RALINK
	config RT2880_FLASH_16M
		bool "16M"
		depends on MTD_SPI_RALINK
	config RT2880_FLASH_32M
		bool "32M"
		depends on MTD_SPI_RALINK
	config RT2880_FLASH_64M
		bool "64M"
		depends on MTD_SPI_RALINK
	config RT2880_FLASH_AUTO
		bool "Autodetect Size"
endchoice

config RALINK_SPI_CS0_HIGH_ACTIVE
	depends on MTD_SPI_RALINK
	bool "SPI CS0 (Chip Select) is high active"
	default n

config RALINK_SPI_CS1_HIGH_ACTIVE
	depends on MTD_SPI_RALINK
	bool "SPI CS1 (Chip Select) is high active"
	default n

config RALINK_SLIC_CONNECT_SPI_CS1
	depends on MTD_SPI_RALINK
	bool "SLIC CS Pin Connects to SPI CS1"
	default n

endif

endmenu
```

## drivers/phy/airoha/Kconfig
```kconfig
#
# PHY drivers for Airoha devices
#
config PHY_AN7552_PCIE
	tristate "Airoha AN7552 PCIe Gen2 PHY driver"
	depends on MACH_AN7552 && OF
	select GENERIC_PHY
	help
	  Say Y here to add support for Airoha PCIe PHY driver.
	  This driver create the basic PHY instance and provides initialize
	  callback for PCIe Gen2 port.

config PHY_AIROHA_PCIE
	tristate "Airoha PCIe Gen3 PHY driver"
	depends on ARCH_AIROHA && OF
	select GENERIC_PHY
	help
	  Say Y here to add support for Airoha PCIe PHY driver.
	  This driver create the basic PHY instance and provides initialize
	  callback for PCIe Gen3 port.

config PHY_AIROHA_USB
	tristate "Airoha USB PHY driver"
	depends on ARCH_AIROHA && OF
	select GENERIC_PHY
	help
	  Say 'Y' here to add support for Airoha USB driver,
	  it supports multiple usb2.0 and usb3.0 ports
```

## ndm/Kconfig
```kconfig
menu "NDM Systems options"

comment "System options"
source "ndm/Kconfig.sys"

comment "Network options"
source "ndm/Kconfig.net"

if !(RALINK_MT7628)
comment "HW NAT options"
menu "Ralink/MTK HW NAT"
source "ndm/Kconfig.ppe"
endmenu
endif

comment "Wireless options"
source "ndm/Kconfig.wifi"

comment "Wireless offload options"
source "ndm/Kconfig.warp"

comment "HW crypto options"
source "ndm/Kconfig.crypto"
endmenu
```

## ndm/Kconfig.net
```kconfig
config UBRIDGE
	tristate "Simplified Ethernet Bridge"
	depends on BRIDGE
	default y

config FAST_NAT
	bool "Fast NAT support"
	depends on NETFILTER
	select NF_NAT_IPV4
	default y

config FAST_NAT_V2
	bool "netfilter fastpath PPTP/L2TP/ESP, fastroute TCP/UDP"
	depends on NETFILTER
	depends on FAST_NAT
	default y

config NTCE_MODULE
	tristate "NTCE module support"
	depends on NF_CONNTRACK_CUSTOM > 0
	default y

config NAT_CONE
	bool "Netfilter Full-Cone/Restricted-Cone NAT mode support for UDP"
	depends on NETFILTER
	default n
	---help---
	  This Netfilter option must be enabled to support Cone NAT mode instead linux hybrid NAT.
	  sysctl -w net.nf_conntrack_nat_mode=0/1/2(Linux/FullCone/RestrictedCone).
	  sysctl -w net.nf_conntrack_nat_cone_ifindex
	  This is processed UDP traffic for direct SIP/uTP and others complex UDP based protocol via NAT.

config NETFILTER_FP_SMB
	bool "Netfilter fastpath to speedup SMB traffic (skip NF handlers)"
	depends on NETFILTER
	default n

config NETFILTER_XT_TARGET_PPE
	tristate '"PPE" ppe disabling target support'
	depends on IP_NF_MANGLE || IP6_NF_MANGLE
	depends on NETFILTER_ADVANCED
	---help---
	  This option adds the "PPE" target to disable fastnat/hwnat
	  offloading for ct

config NETFILTER_XT_NDMMARK
	tristate 'ndmmark target and match support'
	depends on NETFILTER_XTABLES
	default m if NETFILTER_ADVANCED=n

config NETFILTER_XT_CONNNDMMARK
	tristate 'ctndmmark target and match support'
	depends on NF_CONNTRACK
	depends on NETFILTER_XTABLES
	depends on NETFILTER_ADVANCED
	select NF_CONNTRACK_MARK

config NETFILTER_XT_MATCH_CONNSKIP
	tristate '"connskip" match support'
	depends on NETFILTER_ADVANCED
	---help---
	  This option adds a "connskip" match.

config NETFILTER_XT_MATCH_TLS
	tristate '"tls" match support'
	depends on NETFILTER_ADVANCED
	select GLOB
	---help---
	  This option adds a "tls" match.

config NF_CT_PROTO_ESP
	tristate 'ESP protocol connection tracking support'
	depends on NETFILTER_ADVANCED
	default m
```
