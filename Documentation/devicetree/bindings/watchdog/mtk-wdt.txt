## ndm/mt7603_ap/Kconfig
```kconfig
config MT7603_AP
	tristate "MT7603E/MT7592N 802.11n AP support"
	select WIRELESS_EXT
	select WEXT_SPY
	select WEXT_PRIV

if MT7603_AP

config MT7603_MBSS_SUPPORT
	bool "MBSSID Support"
	default y

config MT7603_WDS_SUPPORT
	bool "WDS Support"
	default n

config MT7603_APCLI_SUPPORT
	bool "AP-Client Support"
	default y

config MT7603_APCLI_CERT_SUPPORT
	bool "AP-Client TGN Cert Support"
	depends on MT7603_APCLI_SUPPORT

config MT7603_MAC_REPEATER_SUPPORT
	bool "MAC Repeater Support"
	depends on MT7603_APCLI_SUPPORT
	default n

config MT7603_CON_WPS_SUPPORT
	bool "Concurrent WPS Support"
	depends on MT7603_APCLI_SUPPORT
	depends on MT7603_WSC_INCLUDED
	depends on MT7603_WSC_V2_SUPPORT
	default n

config MT7603_PASSPOINT_R2
	bool "Passpoint Release-2 Support"
	select MT7603_DOT11W_PMF_SUPPORT
	default n

config MT7603_AIRPLAY_SUPPORT
	bool "AirPlay Support"
	default n

config MT7603_BAND_STEERING
	bool "Band Steering Support"
	default n

config MT7603_LLTD_SUPPORT
	bool "LLTD (Link Layer Topology Discovery Protocol) Support"
	default n

config MT7603_IDS_SUPPORT
	bool "IDS (Intrusion Detection System) Support"
	default n

#config MT7603_COC_SUPPORT
#	bool "GreenAP Support"
#	default n

config MT7603_IGMP_SNOOP_SUPPORT
	bool "IGMP Snooping Support"
	default y

#config MT7603_MCAST_RATE_SPECIFIC
#	bool "User Specific Tx Rate of MCAST Packet"

endif # MT7603_AP
```

## ndm/mt7610_ap/Kconfig
```kconfig
config MT7610_AP
	tristate "MT7610E 802.11ac AP support"
	select WIRELESS_EXT
	select WEXT_SPY
	select WEXT_PRIV

if MT7610_AP

config MT7610_MBSS_SUPPORT
	bool "MBSSID support"
	default y

config MT7610_NEW_MBSSID_MODE
	bool "New MBSSID Mode"
	depends on MT7610_MBSS_SUPPORT
	default y

config MT7610_ENHANCE_NEW_MBSSID_MODE
	bool "Enhanced MBSSID Mode"
	depends on MT7610_NEW_MBSSID_MODE
	default y

config MT7610_WDS_SUPPORT
	bool "WDS support"
	default n

config MT7610_APCLI_SUPPORT
	bool "AP-Client support"
	default y

config MT7610_MAC_REPEATER_SUPPORT
	bool "MAC Repeater support"
	depends on MT7610_APCLI_SUPPORT
	default n

config MT7610_CON_WPS_SUPPORT
	bool "Concurrent WPS support"
	depends on MT7610_APCLI_SUPPORT
	depends on MT7610_WSC_INCLUDED
	depends on MT7610_WSC_V2_SUPPORT
	default n

config MT7610_BAND_STEERING
	bool "Band Steering"
	default n

config MT7610_LLTD_SUPPORT
	bool "LLTD (Link Layer Topology Discovery Protocol)"
	default n

#config MT7610_IDS_SUPPORT
#	bool "IDS (Intrusion Detection System)"
#	default n

config MT7610_IGMP_SNOOP_SUPPORT
	bool "IGMP snooping"
	default y

#config MT7610_MCAST_RATE_SPECIFIC
#	bool "User specific tx rate of mcast pkt"
#	default n

#-------------------------------------------------

config MT7610_LED_CONTROL_SUPPORT
	bool "LED support"
	default y

config MT7610_LED_PHR_CONTROL_SUPPORT
	bool "Soft-LED control support (NDM phr)"
	depends on MT7610_LED_CONTROL_SUPPORT
	default y

config MT7610_WSC_INCLUDED
	bool "WSC (WiFi Simple Config)"
	default y

config MT7610_WSC_V2_SUPPORT
	bool "WSC 2.0 (WiFi Simple Config 2.0)"
	depends on MT7610_WSC_INCLUDED
	default y

config MT7610_DOT11_VHT_AC
	bool "802.11ac support"
	default y

config MT7610_DOT11N_DRAFT3
	bool "802.11n Draft3 support"
	default n

#config MT7610_QOS_DLS_SUPPORT
#	bool "802.11e DLS (Direct-Link Setup)"
#	default n

config MT7610_DFS_SUPPORT
	bool "802.11h DFS support"
	default n

config MT7610_DOT11R_FT_SUPPORT
	bool "802.11r Fast BSS Transition"
	default n

config MT7610_DOT11K_RRM_SUPPORT
	bool "802.11k Radio Resource Management"
	default n

config MT7610_DOT11V_WNM_SUPPORT
	bool "802.11v Wireless Network Management"
	default n

config MT7610_CARRIER_DETECTION_SUPPORT
	bool "Carrier detect support"
	default n

config MT7610_ED_MONITOR_SUPPORT
	bool "ED-CCA Monitor support"
	default y

choice
	prompt "Tx Power Compensation"
	default MT7610_TEMPERATURE_COMPENSATION

	config MT7610_TSSI_COMPENSATION
		bool "TSSI DC Calibration & TSSI compensation"
	config MT7610_TEMPERATURE_COMPENSATION
		bool "Tx Power temperature compensation"
endchoice

config MT7610_SINGLE_SKU
	bool "SingleSKU V2 support"
	default n

config MT7610_CFG80211_SUPPORT
	bool "CFG80211 support"
	default n

endif # MT7610_AP
```

## ndm/mt7613/Kconfig
```kconfig
if (MT7613_AP || MT7613_STA)

comment "MT7613E common settings"

config MT7613_LED_CONTROL_SUPPORT
	bool "LED support"
	default y

config MT7613_LED_PHR_CONTROL_SUPPORT
	bool "Soft-LED control support (NDM phr)"
	depends on MT7613_LED_CONTROL_SUPPORT
	default y

config MT7613_WSC_INCLUDED
	bool "WSC (WiFi Simple Config) support"
	default y

config MT7613_WSC_V2_SUPPORT
	bool "WSC V2 (WiFi Simple Config v2.0)"
	depends on MT7613_WSC_INCLUDED
	default y

config MT7613_DOT11_VHT_AC
	bool "802.11ac support"
	default y

config MT7613_G_BAND_256QAM_SUPPORT
	bool "2.4G 256QAM support"
	depends on MT7613_DOT11_VHT_AC
	default y

config MT7613_MUMIMO_SUPPORT
	bool "MU-MIMO support"
	default n

config MT7613_MU_RA_SUPPORT
	bool "MU-RGA support"
	depends on MT7613_MUMIMO_SUPPORT
	default n

config MT7613_DOT11W_PMF_SUPPORT
	bool "802.11w PMF (Protected Management Frames)"
	default y

config MT7613_DOT11R_FT_SUPPORT
	bool "802.11r Fast BSS Transition"
	default n

config MT7613_DOT11K_RRM_SUPPORT
	bool "802.11k Radio Resource Management"
	default n

config MT7613_DOT11V_WNM_SUPPORT
	bool "802.11v Wireless Network Management"
	default n

config MT7613_DOT11U_GAS_SUPPORT
	bool "802.11u Interworking/Gas Support"
	default n

config MT7613_TPC_SUPPORT
	bool "802.11h TPC support"
	default n

config MT7613_DFS_SUPPORT
	bool "802.11h DFS support"
	default n

config MT7613_BACKGROUND_SCAN_SUPPORT
	bool "Background Channels Scan support"
	default y

config MT7613_TXBF_SUPPORT
	bool "Tx Beam Forming support"
	default n

config MT7613_SMART_CARRIER_SENSE_SUPPORT
	bool "Smart Carrier Sense support"
	default y

config MT7613_TCP_RACK_SUPPORT
	bool "TCP Reduced ACK support"
	default n

config MT7613_SINGLE_SKU
	bool "Single SKU V2 support"
	default n

config MT7613_PCIE_ASPM_DYM_CTRL_SUPPORT
	bool "PCIe ASPM Dynamic Control Support"
	default y

config MT7613_CFG80211_SUPPORT
	bool "CFG80211"
	default n

endif # (MT7613_AP || MT7613_STA)
```

## ndm/mt7613_ap/Kconfig
```kconfig
config MT7613_AP
	tristate "MT7613E 802.11ac AP support"
	select WIRELESS_EXT
	select WEXT_SPY
	select WEXT_PRIV

if MT7613_AP

config MT7613_MBSS_SUPPORT
	bool "MBSSID support"
	default y

config MT7613_WDS_SUPPORT
	bool "WDS support"
	default n

config MT7613_APCLI_SUPPORT
	bool "AP-Client support"
	default y

config MT7613_APCLI_CERT_SUPPORT
	bool "AP-Client TGN Cert support"
	depends on MT7613_APCLI_SUPPORT
	default n

config MT7613_MAC_REPEATER_SUPPORT
	bool "MAC Repeater support"
	depends on MT7613_APCLI_SUPPORT
	default n

config MT7613_CON_WPS_SUPPORT
	bool "Concurrent WPS support"
	depends on MT7613_APCLI_SUPPORT
	depends on MT7613_WSC_INCLUDED
	depends on MT7613_WSC_V2_SUPPORT
	default n

config MT7613_PASSPOINT_R2
	bool "Passpoint Release-2 support"
	select MT7613_DOT11W_PMF_SUPPORT
	default n

#config MT7613_AIRPLAY_SUPPORT
#	bool "AirPlay support"
#	default n

config MT7613_FTM_SUPPORT
	bool "FTM support"
	select MT7613_PASSPOINT_R2
	default n

config MT7613_MBO_SUPPORT
	bool "MBO support"
	select MT7613_DOT11K_RRM_SUPPORT
	select MT7613_DOT11R_FT_SUPPORT
	select MT7613_DOT11V_WNM_SUPPORT
	select MT7613_DOT11U_GAS_SUPPORT
	default n

config MT7613_OCE_SUPPORT
	bool "Optimized Connectivity Experience support"
	default n

config MT7613_MAP_SUPPORT
	bool "Multi-AP Support"
	default y

config MT7613_WAPP_SUPPORT
	bool "MTK wapp daemon support"
	default n

config MT7613_VOW_SUPPORT
	bool "MediaAir (VOW) support"
	default y

config MT7613_RED_SUPPORT
	bool "RED (Random Early Drop) support"
	default y

config MT7613_WPA3_SUPPORT
	bool "WPA3 auth support"
	default y

config MT7613_OWE_SUPPORT
	bool "Enhanced OPEN(OWE) auth support"
	depends on MT7613_WPA3_SUPPORT
	default y

config MT7613_DSCP_PRI_SUPPORT
	bool "DSCP Priority Mapping support"
	default n

config MT7613_BAND_STEERING
	bool "Band Steering support"
	default n

#config MT7613_LLTD_SUPPORT
#	bool "LLTD (Link Layer Topology Discovery Protocol) support"
#	default n

#config MT7613_IDS_SUPPORT
#	bool "IDS (Intrusion Detection System) support"
#	default n

config MT7613_GREENAP_SUPPORT
	bool "GreenAP support"
	default n

config MT7613_IGMP_SNOOP_SUPPORT
	bool "IGMP Snooping support"
	default y

config MT7613_MCAST_RATE_SPECIFIC
	bool "User Specific Tx Rate of MCAST Packet"
	default n

config MT7613_RADIUS_ACCOUNTING_SUPPORT
	bool "Radius Accounting support"
	default n

config MT7613_ICAP_SUPPORT
	bool "Internal Capture support"
	default n

endif # MT7613_AP
```

## ndm/mt7615/Kconfig
```kconfig
if (MT7615_AP || MT7615_STA)

comment "MT7622/MT7615E common settings"

config MT7615_DBDC_MODE
	bool "DBDC mode support"
	default y

config MT7615_MULTI_PROFILE_SUPPORT
	bool "Multi Profile Support"
	depends on MT7615_DBDC_MODE
	default n

config MT7615_DEFAULT_5G_PROFILE
	bool "5G default profile for DBDC"
	depends on MT7615_DBDC_MODE
	default n

config MT7615_LED_CONTROL_SUPPORT
	bool "LED support"
	default y

config MT7615_LED_PHR_CONTROL_SUPPORT
	bool "Soft-LED control support (NDM phr)"
	depends on MT7615_LED_CONTROL_SUPPORT
	default y

config MT7615_WSC_INCLUDED
	bool "WSC (WiFi Simple Config) support"
	default y

config MT7615_WSC_V2_SUPPORT
	bool "WSC V2 (WiFi Simple Config v2.0)"
	depends on MT7615_WSC_INCLUDED
	default y

config MT7615_DOT11_VHT_AC
	bool "802.11ac support"
	default y

config MT7615_G_BAND_256QAM_SUPPORT
	bool "2.4G 256QAM support"
	depends on MT7615_DOT11_VHT_AC
	default y

config MT7615_MUMIMO_SUPPORT
	bool "MU-MIMO support"
	default y

config MT7615_MU_RA_SUPPORT
	bool "MU-RGA support"
	depends on MT7615_MUMIMO_SUPPORT
	default y

config MT7615_DOT11W_PMF_SUPPORT
	bool "802.11w PMF (Protected Management Frames)"
	default y

config MT7615_DOT11R_FT_SUPPORT
	bool "802.11r Fast BSS Transition"
	default n

config MT7615_DOT11K_RRM_SUPPORT
	bool "802.11k Radio Resource Management"
	default n

config MT7615_DOT11V_WNM_SUPPORT
	bool "802.11v Wireless Network Management"
	default n

config MT7615_DOT11U_GAS_SUPPORT
	bool "802.11u Interworking/Gas Support"
	default n

config MT7615_TPC_SUPPORT
	bool "802.11h TPC support"
	default n

config MT7615_DFS_SUPPORT
	bool "802.11h DFS support"
	default n

config MT7615_BACKGROUND_SCAN_SUPPORT
	bool "Background Channels Scan support"
	default n

config MT7615_TXBF_SUPPORT
	bool "Tx Beam Forming support"
	default y

config MT7615_SMART_CARRIER_SENSE_SUPPORT
	bool "Smart Carrier Sense support"
	default y

config MT7615_TCP_RACK_SUPPORT
	bool "TCP Reduced ACK support"
	default n

config MT7615_SINGLE_SKU
	bool "Single SKU V2 support"
	default n

config MT7615_RF_LOCKDOWN_SUPPORT
	bool "Single SKU RF lockdown support"
	depends on MT7615_SINGLE_SKU
	default n

config MT7615_PRECAL_SUPPORT
	bool "Allow PRECAL w/o ATE build"
	default n

config MT7615_WHNAT_SUPPORT
	tristate "Wifi Warp Hardware NAT support"
	depends on CHIP_MT7622 || ECONET_EN7528
	depends on CHIP_MT7615E
	default m

config MT7615_PCIE_ASPM_DYM_CTRL_SUPPORT
	bool "PCIe ASPM Dynamic Control Support"
	depends on CHIP_MT7615E
	default y

config MT7615_PCIE_MSI_SUPPORT
	bool "MSI interrupts support"
	depends on PCI_MSI
	depends on CHIP_MT7615E
	default n

config MT7615_CFG80211_SUPPORT
	bool "CFG80211"
	default n

config MT7615_CUSTOMIZED_HOSTAPD
	bool "Customized Hostapd Support"
	depends on MT7615_CFG80211_SUPPORT
	default n

endif # (MT7615_AP || MT7615_STA)
```

## ndm/mt7615_ap/Kconfig
```kconfig
config MT7615_AP
	tristate "MT7622/MT7615E 802.11ac AP support"
	select WIRELESS_EXT
	select WEXT_SPY
	select WEXT_PRIV

if MT7615_AP

config MT7615_MBSS_SUPPORT
	bool "MBSSID support"
	default y

config MT7615_WDS_SUPPORT
	bool "WDS support"
	default n

config MT7615_APCLI_SUPPORT
	bool "AP-Client support"
	default y

config MT7615_APCLI_ROAM_SUPPORT
	bool "AP-Client Roam support"
	default y

config MT7615_APCLI_CERT_SUPPORT
	bool "AP-Client TGN Cert support"
	depends on MT7615_APCLI_SUPPORT
	default n

config MT7615_MAC_REPEATER_SUPPORT
	bool "MAC Repeater support"
	depends on MT7615_APCLI_SUPPORT
	default n

config MT7615_CON_WPS_SUPPORT
	bool "Concurrent WPS support"
	depends on MT7615_APCLI_SUPPORT
	depends on MT7615_WSC_INCLUDED
	depends on MT7615_WSC_V2_SUPPORT
	default n

config MT7615_PASSPOINT_R2
	bool "Passpoint Release-2 support"
	select MT7615_DOT11W_PMF_SUPPORT
	default n

#config MT7615_AIRPLAY_SUPPORT
#	bool "AirPlay support"
#	default n

config MT7615_FTM_SUPPORT
	bool "FTM support"
	select MT7615_PASSPOINT_R2
	default n

config MT7615_MBO_SUPPORT
	bool "MBO support"
	select MT7615_DOT11K_RRM_SUPPORT
	select MT7615_DOT11R_FT_SUPPORT
	select MT7615_DOT11V_WNM_SUPPORT
	select MT7615_DOT11U_GAS_SUPPORT
	default n

config MT7615_OCE_SUPPORT
	bool "Optimized Connectivity Experience support"
	default n

config MT7615_MAP_SUPPORT
	bool "Multi-AP Support"
	default y

config MT7615_WAPP_SUPPORT
	bool "MTK wapp daemon support"
	default n

config MT7615_VOW_SUPPORT
	bool "MediaAir (VOW) support"
	default y

config MT7615_RED_SUPPORT
	bool "RED (Random Early Drop) support"
	default y

config MT7615_WPA3_SUPPORT
	bool "WPA3 auth support"
	default y

config MT7615_OWE_SUPPORT
	bool "Enhanced OPEN(OWE) auth support"
	depends on MT7615_WPA3_SUPPORT
	default y

config MT7615_DSCP_QOS_MAP_SUPPORT
	bool "DSCP Qos Mapping Support"
	default n

config MT7615_BAND_STEERING
	bool "Band Steering support"
	default n

#config MT7615_LLTD_SUPPORT
#	bool "LLTD (Link Layer Topology Discovery Protocol) support"
#	default n

#config MT7615_IDS_SUPPORT
#	bool "IDS (Intrusion Detection System) support"
#	default n

config MT7615_GREENAP_SUPPORT
	bool "GreenAP support"
	default n

config MT7615_IGMP_SNOOP_SUPPORT
	bool "IGMP Snooping support"
	default y

config MT7615_MCAST_RATE_SPECIFIC
	bool "User Specific Tx Rate of MCAST Packet"
	default n

config MT7615_RADIUS_ACCOUNTING_SUPPORT
	bool "Radius Accounting support"
	default n

config MT7615_ICAP_SUPPORT
	bool "Internal Capture support"
	default n

endif # MT7615_AP
```

## ndm/mt7628/Kconfig
```kconfig
if (MT7628_AP || MT7628_STA)

comment "MT7628/MT7688 common settings"

config MT7628_LED_CONTROL_SUPPORT
	bool "LED Support"
	default y

config MT7628_LED_PHR_CONTROL_SUPPORT
	bool "Soft-LED Control Support (NDM phr)"
	depends on MT7628_LED_CONTROL_SUPPORT
	default y

config MT7628_RATE_ADAPTION
	bool "Rate Adaptation Support"
	default y

config MT7628_NEW_RATE_ADAPT_SUPPORT
	bool "Intelligent Rate Adaption Support"
	depends on MT7628_RATE_ADAPTION
	default y

config MT7628_AGS_SUPPORT
	bool "Adaptive Group Switching Support"
	depends on MT7628_RATE_ADAPTION
	default n

config MT7628_WSC_INCLUDED
	bool "WSC (WiFi Simple Config) Support"
	default y

config MT7628_WSC_V2_SUPPORT
	bool "WSC V2 (WiFi Simple Config v2.0)"
	depends on MT7628_WSC_INCLUDED
	default y

config MT7628_DOT11W_PMF_SUPPORT
	bool "802.11w PMF (Protected Management Frames)"
	default y

config MT7628_DOT11R_FT_SUPPORT
	bool "802.11r Fast BSS Transition"
	default n

config MT7628_DOT11K_RRM_SUPPORT
	bool "802.11k Radio Resource Management"
	default n

config MT7628_DOT11V_WNM_SUPPORT
	bool "802.11v Wireless Network Management"
	default n

config MT7628_QOS_DLS_SUPPORT
	bool "802.11e DLS (Direct-Link Setup)"
	default n

config MT7628_SMART_CARRIER_SENSE_SUPPORT
	bool "Smart Carrier Sense Support"
	default y

config MT7628_SINGLE_SKU
	bool "Single SKU Support"
	default n

config MT7628_SNIFFER_SUPPORT
	bool "SNIFFER Support"
	default n

#config MT7628_TRACE_IPARP
#	bool "IP/ARP trace log"

endif # (MT7628_AP || MT7628_STA)
```
