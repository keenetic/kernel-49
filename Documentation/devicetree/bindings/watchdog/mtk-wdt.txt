## ndm/Kconfig.ppe
```kconfig
config  RA_HW_NAT
	tristate "Ralink/MTK HW NAT (** Work At Module Mode ONLY **)"
	depends on !(RALINK_MT7628)

if RA_HW_NAT

config  HNAT_V2
	bool
	default y

config  HNAT_ENHANCED
	bool
	default y

config  RA_HW_NAT_DUAL_PPE
	bool "Dual PPE0 plus PPE1 offload"
	depends on (MACH_MT7981 || MACH_MT7986 || MACH_MT7988)
	default n

config  RA_HW_NAT_TRIPLE_PPE
	bool "Triple PPE0/PPE1/PPE2 offload"
	depends on (MACH_MT7988)
	default n

config  RA_HW_NAT_BINDING_THRESHOLD
	int "Binding Threshold (Unit:Packet Per Second)"
	default 30
	help
	  When flow rate > Binding Threshold  (# Packets Per Second),
	  the state will change to bind state

choice
	prompt "Foe Table Size"
	default RA_HW_NAT_TBL_16K
	help
	  Number of entries in FoE Table

	config  RA_HW_NAT_TBL_1K
		bool "1K"
	config  RA_HW_NAT_TBL_2K
		bool "2K"
	config  RA_HW_NAT_TBL_4K
		bool "4K"
	config  RA_HW_NAT_TBL_8K
		bool "8K"
	config  RA_HW_NAT_TBL_16K
		bool "16K"
	config  RA_HW_NAT_TBL_32K
		bool "32K"
		depends on (MACH_MT7981 || MACH_MT7986 || MACH_MT7988)
endchoice

choice
	prompt "Hash Algorithm"
	default RA_HW_NAT_HASH1

	config  RA_HW_NAT_HASH0
		bool "Hash0-Simple"
	config  RA_HW_NAT_HASH1
		bool "Hash1-Complex"
	config  RA_HW_NAT_HASH2
		bool "Hash2-Complex"
	config  RA_HW_NAT_HASH3
		bool "Hash3-Complex"
	config  RA_HW_NAT_HASH_DBG
		bool "Hash-Debug"
		depends on (MACH_MT7622 || MACH_MT7623 || MACH_MT7629 || MACH_MT7981 || MACH_MT7986 || MACH_MT7988)
endchoice

choice
	prompt "Hash DBG Mode"
	depends on RA_HW_NAT_HASH_DBG
	default RA_HW_NAT_HASH_DBG_SPORT

	config  RA_HW_NAT_HASH_DBG_IPV6_SIP
		bool "IPv6 source IP[15:0]"
	config  RA_HW_NAT_HASH_DBG_IPV4_SIP
		bool "IPv4 source IP[15:0]"
	config  RA_HW_NAT_HASH_DBG_SPORT
		bool "source port[15:0]"
endchoice

config  RA_HW_NAT_TCP_KA
	int "TCP KeepAlive Interval (Unit: Sec * TblSize)"
	default 1
	help
	  HW will duplicate one TCP packet from tcp bind flow to CPU
	  in order to refresh Linux conntrack table.

config  RA_HW_NAT_UDP_KA
	int "UDP KeepAlive Interval (Unit: Sec * TblSize)"
	default 1
	help
	  HW will duplicate one UDP packet from tcp bind flow to CPU
	  in order to refresh Linux conntrack table.

config  RA_HW_NAT_NTU_KA
	int "Non-TCP/UDP KeepAlive Interval (Unit: Sec * TblSize)"
	default 1
	help
	  HW will duplicate one packet from tcp bind flow to CPU
	  in order to refresh Linux conntrack table.

config  RA_HW_NAT_UNB_DLTA
	int "Life time of Unbind entry (Unit:1Sec)"
	default 3
	help
	  Set ageout time for bind Unbind entry

config  RA_HW_NAT_UNB_MNP
	int "Min threshold for unbind state(Pkt count)"
	default 1000
	help
	  An unbind flow whose pkt counts < Min threshold and idle time > Life time 
	  => This unbind entry would be aged out
	  [Notes: Idle time = current time - last packet receive time]

config  RA_HW_NAT_UDP_DLTA
	int "Life time of Bind UDP entry (Unit:1Sec)"
	default 5
	help
	  Set ageout time for bind UDP entry

config  RA_HW_NAT_TCP_DLTA
	int "Life time of Bind TCP entry (Unit:1Sec)"
	default 5
	help
	  Set ageout time for bind TCP entry

config  RA_HW_NAT_FIN_DLTA
	int "Life time of Bind FIN entry (Unit:1Sec)"
	default 5
	help
	  Set ageout time for FIN entry

config  RA_HW_NAT_NTU_DLTA
	int "Life time of Non-TCP/UDP entry (Unit:1Sec)"
	default 5
	help
	  Set ageout time for Non-TCP/UDP entry

config  RA_HW_NAT_PREBIND
	bool "Pre-bind support"
	default n

config  RA_HW_NAT_PBND_RD_PRD
	int "Check interval in pause state (us) Max:65535"
	depends on RA_HW_NAT_PREBIND
	default 1000

config  RA_HW_NAT_PBND_RD_LMT
	int "Max retry count"
	depends on RA_HW_NAT_PREBIND
	default 10

config  RA_HW_NAT_PACKET_SAMPLING
	bool "Packet Sampling to CPU"
	depends on (MACH_MT7622 || MACH_MT7623 || MACH_MT7629 || MACH_MT7981 || MACH_MT7986 || MACH_MT7988)

config  RA_HW_NAT_L2B
	bool "L2 Bridge Acceleration"
	depends on ECONET_EN75XX_MP
	default n
	help
	  L2 bridge forwards accelerated by HNAT

config  RA_HW_NAT_IPV6
	bool "IPv6 Acceleration"
	depends on IPV6
	default n
	help
	  IPv6 routing accelerated by HNAT

config  RA_HW_NAT_ADSL
	bool "ADSL/ADSL2 Acceleration"
	depends on ECONET_EN75XX_MP && TC3162_ADSL
	default n
	help
	  ADSL/ADSL2 accelerated by HNAT

config  RA_HW_NAT_VDSL
	bool "VDSL/VDSL2 Acceleration"
	depends on ECONET_EN75XX_MP && RALINK_VDSL
	default y
	help
	  VDSL/VDSL2 accelerated by HNAT

config  RA_HW_NAT_QDMA
	bool "Flow out to QDMA (HW QoS)"
	default y
	help
	  HW QoS concurrent with HNAT

config  RA_HW_NAT_MCAST
	bool "Multicast Acceleration"
	default n
	help
	  Multicast flow accelerated by HNAT

config  RA_HW_NAT_WIFI
	bool "WiFi Acceleration"
	default n

config  RA_HW_NAT_WHNAT
	bool "WiFi Warp Acceleration"
	depends on RA_HW_NAT_WIFI && (ECONET_EN7528 || MACH_MT7622 || MACH_MT7981 || MACH_MT7986 || MACH_MT7988)

config  RA_HW_NAT_NIC_USB
	bool "USBNET Acceleration"
	depends on USB_USBNET

endif
```

## ndm/Kconfig.sys
```kconfig
config NDM_RNG_SEED
	bool "Helper for seed RNG during kernel init"
	select MTD
	select CRYPTO_SHA256
	default y
```

## ndm/Kconfig.warp
```kconfig
config MTK_WARP
	tristate "MediaTek WARP driver"
	depends on (MACH_AN7552 || MACH_MT7981 || MACH_MT7986 || MACH_MT7988)

if MTK_WARP

config MTK_WARP_HW_RRO
	bool "HW RX offload support"
	depends on !(MACH_AN7552)
	default y

config MTK_WARP_MEMORY_SHRINK
	bool "Memory shrink for static BM"
	default n
	help
	  Save RAM with static buffer management.

config MTK_WARP_DBG
	bool "WARP driver debug info support"
	default n

config MTK_WARP_DBG_MEMLEAK
	bool "Memory leak debug"
	depends on MTK_WARP_DBG && !MTK_WARP_MEMORY_SHRINK
	default n

endif
```

## ndm/Kconfig.wifi
```kconfig
menuconfig WIFI_DRIVER
	bool "Wi-Fi driver support"

if WIFI_DRIVER

choice
	prompt "Choose first Wi-Fi interface"

	config FIRST_IF_NONE
	bool "None"

	config FIRST_IF_MT7628
	bool "MT7628/MT7688 integrated radio"
	depends on RALINK_MT7628
	select MT_MAC

	config FIRST_IF_MT7622
	bool "MT7622 integrated radio"
	depends on MACH_MT7622
	select MT_MAC
	select CHIP_MT7622

	config FIRST_IF_MT7981
	bool "MT7981 integrated radio"
	depends on MACH_MT7981
	select MT_MAC
	select CHIP_MT7981

	config FIRST_IF_MT7986
	bool "MT7986 integrated radio"
	depends on MACH_MT7986
	select MT_MAC
	select CHIP_MT7986

	config FIRST_IF_MT7602E
	bool "MT7602E"
	depends on RALINK_MT7621
	select RLT_MAC
	select RALINK_MT7612E

	config FIRST_IF_MT7603E
	bool "MT7603E/MT7592N"
	depends on (RALINK_MT7621 || ECONET_EN75XX_MP || MACH_MT7623)
	select MT_MAC
	select CHIP_MT7603E

	config FIRST_IF_MT7615E
	bool "MT7615D/N"
	depends on (RALINK_MT7621 || ECONET_EN75XX_MP || MACH_MT7623)
	select MT_MAC
	select CHIP_MT7615E

	config FIRST_IF_MT7915
	bool "MT7915D/A"
	depends on (RALINK_MT7621 || ECONET_EN75XX_MP || MACH_EN7523 || MACH_MT7622 || MACH_MT7623)
	select MT_MAC
	select CHIP_MT7915

	config FIRST_IF_MT7916
	bool "MT7916AN"
	depends on (MACH_EN7523 || MACH_MT7622 || MACH_MT7623 || MACH_MT7988 || MACH_AN7581 || MACH_AN7583)
	select MT_MAC
	select CHIP_MT7916

	config FIRST_IF_MT7990
	bool "MT7990 series (Eagle), SKU BE19000/13000"
	depends on (MACH_MT7988 || MACH_AN7581 || MACH_AN7583)
	select MT_MAC
	select CHIP_MT7990

	config FIRST_IF_MT7992
	bool "MT7992 series (Kite), SKU BE7200/6500/5040/3600SDB"
	depends on (MACH_MT7988 || MACH_AN7581 || MACH_AN7583)
	select MT_MAC
	select CHIP_MT7992

	config FIRST_IF_MT7993
	bool "MT7993 series (Griffin), SKU BE3600"
	depends on (MACH_MT7988)
	select MT_MAC
	select CHIP_MT7993

endchoice

choice
	prompt "A-die type for Panther"
	depends on FIRST_IF_MT7986

	config FIRST_IF_ADIE_MT7975
	bool "MT7975"

	config FIRST_IF_ADIE_MT7976
	bool "MT7976"
endchoice

choice
	prompt "SKU type"
	depends on (FIRST_IF_MT7986 || FIRST_IF_MT7990 || FIRST_IF_MT7992)

	config FIRST_IF_SKU_AX4200
	depends on FIRST_IF_MT7986
	bool "AX4200"

	config FIRST_IF_SKU_AX6000
	depends on FIRST_IF_MT7986
	bool "AX6000"

	config FIRST_IF_SKU_BE3600SDB
	depends on FIRST_IF_MT7992
	bool "BE3600SDB (Selectable Dual Band), 2die"

	config FIRST_IF_SKU_BE5040
	depends on FIRST_IF_MT7992
	bool "BE5040 (MT7991AV), 1die"

	config FIRST_IF_SKU_BE6500
	depends on FIRST_IF_MT7992
	bool "BE6500 (MT7992BV), 2die"

	config FIRST_IF_SKU_BE7200
	depends on FIRST_IF_MT7992
	bool "BE7200 (MT7992AV), 2die"

	config FIRST_IF_SKU_BE13000
	depends on FIRST_IF_MT7990
	bool "BE13000 (2.4/5/5)"

	config FIRST_IF_SKU_BE19000
	depends on FIRST_IF_MT7990
	bool "BE19000 (2.4/5/6)"
endchoice

choice
	prompt "EEPROM type of 1st card"
	depends on ! FIRST_IF_NONE

	config FIRST_IF_EEPROM_PROM
	bool "EEPROM"

	config FIRST_IF_EEPROM_EFUSE
	bool "EFUSE"

	config FIRST_IF_EEPROM_FLASH
	bool "FLASH"
endchoice

choice
	prompt "PA & LNA type of 1st card"
	depends on !(FIRST_IF_NONE || FIRST_IF_MT7628 || FIRST_IF_MT7602E || FIRST_IF_MT7603E)

	config FIRST_IF_EPAELNA
	bool "ePA/eLNA"

	config FIRST_IF_IPAILNA
	bool "iPA/iLNA"

	config FIRST_IF_IPAELNA
	bool "iPA/eLNA"
endchoice

choice
	prompt "Choose second Wi-Fi interface"

	config SECOND_IF_NONE
	bool "None"

	config SECOND_IF_MT7610E
	bool "MT7610E"
	depends on PCI
	select RLT_MAC
	select RALINK_MT7610E

	config SECOND_IF_MT7612E
	bool "MT7612E"
	depends on PCI
	select RLT_MAC
	select RALINK_MT7612E

	config SECOND_IF_MT7613E
	bool "MT7613E"
	depends on PCI
	select MT_MAC
	select CHIP_MT7663E

	config SECOND_IF_MT7615E
	bool "MT7615D/N"
	depends on PCI
	select MT_MAC
	select CHIP_MT7615E

	config SECOND_IF_MT7915
	bool "MT7915D/A"
	depends on PCI
	select MT_MAC
	select CHIP_MT7915

	config SECOND_IF_MT7916
	bool "MT7916AN"
	depends on PCI
	select MT_MAC
	select CHIP_MT7916

endchoice

choice
	prompt "EEPROM type of 2nd card"
	depends on ! SECOND_IF_NONE

	config SECOND_IF_EEPROM_PROM
	bool "EEPROM"

	config SECOND_IF_EEPROM_EFUSE
	bool "EFUSE"

	config SECOND_IF_EEPROM_FLASH
	bool "FLASH"
endchoice

choice
	prompt "PA & LNA type of 2nd card"
	depends on !(SECOND_IF_NONE || SECOND_IF_MT7610E || SECOND_IF_MT7612E || SECOND_IF_MT7613E)

	config SECOND_IF_EPAELNA
	bool "ePA/eLNA"

	config SECOND_IF_IPAILNA
	bool "iPA/iLNA"

	config SECOND_IF_IPAELNA
	bool "iPA/eLNA"
endchoice

config RT_FIRST_CARD
	int
	depends on ! FIRST_IF_NONE
	default 7628 if FIRST_IF_MT7628
	default 7622 if FIRST_IF_MT7622
	default 7981 if FIRST_IF_MT7981
	default 7986 if FIRST_IF_MT7986
	default 7602 if FIRST_IF_MT7602E
	default 7603 if FIRST_IF_MT7603E
	default 7615 if FIRST_IF_MT7615E
	default 7915 if FIRST_IF_MT7915
	default 7916 if FIRST_IF_MT7916
	default 7990 if FIRST_IF_MT7990
	default 7992 if FIRST_IF_MT7992
	default 7993 if FIRST_IF_MT7993

config RT_SECOND_CARD
	int
	depends on ! SECOND_IF_NONE
	default 7610 if SECOND_IF_MT7610E
	default 7612 if SECOND_IF_MT7612E
	default 7613 if SECOND_IF_MT7613E
	default 7615 if SECOND_IF_MT7615E
	default 7915 if SECOND_IF_MT7915
	default 7916 if SECOND_IF_MT7916

config RT_FIRST_IF_RF_OFFSET
	hex "EEPROM offset of 1st card"
	depends on ! FIRST_IF_NONE
	default 0x0

config RT_SECOND_IF_RF_OFFSET
	hex "EEPROM offset of 2nd card"
	depends on ! SECOND_IF_NONE
	default 0x8000

config RT_FIRST_CARD_EEPROM
	string
	depends on ! FIRST_IF_NONE
	default "prom" if FIRST_IF_EEPROM_PROM
	default "efuse" if FIRST_IF_EEPROM_EFUSE
	default "flash" if FIRST_IF_EEPROM_FLASH

config RT_SECOND_CARD_EEPROM
	string
	depends on ! SECOND_IF_NONE
	default "prom" if SECOND_IF_EEPROM_PROM
	default "efuse" if SECOND_IF_EEPROM_EFUSE
	default "flash" if SECOND_IF_EEPROM_FLASH

config RTMP_MAC
	bool

config RLT_MAC
	bool

config MT_MAC
	bool

config RTMP_RBUS_SUPPORT
	bool

config RTMP_PCI_SUPPORT
	bool

config RTMP_USB_SUPPORT
	bool

config MULTI_INF_SUPPORT
	bool
	default y if (RTMP_RBUS_SUPPORT && RTMP_PCI_SUPPORT)

config RALINK_MT7610E
	bool
	select RTMP_PCI_SUPPORT

config RALINK_MT7612E
	bool
	select RTMP_PCI_SUPPORT

config CHIP_MT7603E
	bool
	select RTMP_PCI_SUPPORT

config CHIP_MT7663E
	bool
	select RTMP_PCI_SUPPORT

config CHIP_MT7615E
	bool
	select RTMP_PCI_SUPPORT

config CHIP_MT7915
	bool
	select RTMP_PCI_SUPPORT

config CHIP_MT7916
	bool
	select RTMP_PCI_SUPPORT

config CHIP_MT7622
	bool
	select RTMP_RBUS_SUPPORT

config CHIP_MT7981
	bool
	select RTMP_RBUS_SUPPORT

config CHIP_MT7986
	bool
	select RTMP_RBUS_SUPPORT

config CHIP_MT7990
	bool
	select RTMP_PCI_SUPPORT

config CHIP_MT7990_2PCIE
	bool "MT7990 configuration with PCIe two 2-lane (MT7988A host)"
	depends on CHIP_MT7990
	default n

config CHIP_MT7992
	bool
	select RTMP_PCI_SUPPORT

config CHIP_MT7992_2PCIE
	bool "MT7992 configuration with PCIe two 1-lane"
	depends on CHIP_MT7992
	default n

config CHIP_MT7993
	bool
	select RTMP_PCI_SUPPORT

config CHIP_MT7993_2PCIE
	bool "MT7993 configuration with PCIe two 1-lane"
	depends on CHIP_MT7993
	default n

config MTK_CONNINFRA
	tristate "Mediatek MT7981/MT7986 on-SoC radio infrastructure connectivity"
	depends on (CHIP_MT7981 || CHIP_MT7986)

if RALINK_MT7628
menu "MediaTek MT7628/MT7688 RBUS Wireless driver"
source "ndm/mt7628_ap/Kconfig"
source "ndm/mt7628/Kconfig"
endmenu
endif

menu "MediaTek MT7620/MT7602E/MT7612E RBUS/PCIe Wireless driver"
source "ndm/mt76x2_ap/Kconfig"
source "ndm/mt76x2/Kconfig"
endmenu

menu "MediaTek MT7603E/MT7592N PCIe Wireless driver"
source "ndm/mt7603_ap/Kconfig"
source "ndm/mt7603/Kconfig"
endmenu

menu "MediaTek MT7610E PCIe Wireless driver"
source "ndm/mt7610_ap/Kconfig"
endmenu

menu "MediaTek MT7613E PCIe Wireless driver"
source "ndm/mt7613_ap/Kconfig"
source "ndm/mt7613/Kconfig"
endmenu

menu "MediaTek MT7622/MT7615E RBUS/PCIe Wireless driver"
source "ndm/mt7615_ap/Kconfig"
source "ndm/mt7615/Kconfig"
endmenu

menu "MediaTek MT7915 PCIe Wireless driver"
source "ndm/mt7915_ap/Kconfig"
source "ndm/mt7915/Kconfig"
endmenu

menu "MediaTek MT7981/MT7986/MT7916AN RBUS/PCIe Wireless driver"
source "ndm/mt7916_ap/Kconfig"
source "ndm/mt7916/Kconfig"
endmenu

menu "MediaTek MT7992 PCIe Wireless driver"
source "ndm/mt7992_ap/Kconfig"
source "ndm/mt7992/Kconfig"
endmenu

menu "Common Wi-Fi settings"
config ATE_SUPPORT
	bool "ATE/QA support"
	default n

config WIFI_DEBUG_SUPPORT
	bool "Debug Mode support"
	default n

config WIFI_SYSDVT
	bool "Design Validation Test support"
	default n

config WIFI_MEMORY_OPTIMIZATION
	bool "Memory Optimization (< 64MB RAM)"
	default n

config WIFI_SKB_RECYCLE
	bool "SKB Recycle (Linux)"
	default n

config WIFI_WORK_QUEUE
	bool "Use BH Workqueue (instead of Tasklets)"
	default n

#config WIFI_PKT_FWD
#	bool "WiFi packet forwarding"
#	default n

#source "drivers/net/wireless/wifi_forward/wifi_fwd/Kconfig"
endmenu

endif # WIFI_DRIVER
```

## ndm/mt7603/Kconfig
```kconfig
if (MT7603_AP || MT7603_STA)

comment "MT7603E/MT7592N common settings"

config MT7603_LED_CONTROL_SUPPORT
	bool "LED Support"
	default y

config MT7603_LED_PHR_CONTROL_SUPPORT
	bool "Soft-LED Control Support (NDM phr)"
	depends on MT7603_LED_CONTROL_SUPPORT
	default y

config MT7603_GPIO_SUPPORT
	bool "GPIO Pins Control Support"
	default n

config MT7603_AGS_SUPPORT
	bool "Adaptive Group Switching Support"
	default n

config MT7603_WSC_INCLUDED
	bool "WSC (WiFi Simple Config) Support"
	default y

config MT7603_WSC_V2_SUPPORT
	bool "WSC V2 (WiFi Simple Config v2.0)"
	depends on MT7603_WSC_INCLUDED
	default y

config MT7603_DOT11W_PMF_SUPPORT
	bool "802.11w PMF (Protected Management Frames)"
	default y

config MT7603_DOT11R_FT_SUPPORT
	bool "802.11r Fast BSS Transition"
	default n

config MT7603_DOT11K_RRM_SUPPORT
	bool "802.11k Radio Resource Management"
	default n

config MT7603_DOT11V_WNM_SUPPORT
	bool "802.11v Wireless Network Management"
	default n

config MT7603_QOS_DLS_SUPPORT
	bool "802.11e DLS (Direct-Link Setup)"
	default n

config MT7603_SMART_CARRIER_SENSE_SUPPORT
	bool "Smart Carrier Sense Support"
	default y

config MT7603_SINGLE_SKU
	bool "Single SKU Support"
	default n

config MT7603_SNIFFER_SUPPORT
	bool "SNIFFER Support"
	default n

endif # (MT7603_AP || MT7603_STA)
```
