## drivers/mtd/nand/spi/Kconfig
```kconfig
menuconfig MTD_SPI_NAND
	tristate "SPI NAND device Support"
	select MTD_NAND_CORE
	depends on SPI_MASTER
	select SPI_MEM
	help
	  This is the framework for the SPI NAND device drivers.

config SPI_NAND_CASN
	bool "SPI NAND CASN page support"
	depends on MTD_SPI_NAND
	default n
	help
	  This is the Common Attributes for SPI NAND (CASN page).
```

## drivers/soc/airoha/Kconfig
```kconfig
#
# Airoha SoC options
#

if ARCH_AIROHA

config MEMBLOCK_NPU_TX_58M
	bool "Large preallocated TX buffer for NPU wifi offload"
	depends on !CONFIG_MACH_AN7552
	default n
	help
	  Preallocate 58M memblock, this is default for Eagle.
	  Otherwise preallocate 26M memblock to save kernel RAM.

config MEMBLOCK_QDMA1
	bool "Preallocate HWF buffer for QDMA1 (LAN)"
	default y

config MEMBLOCK_QDMA2
	bool "Preallocate HWF buffer for QDMA2 (WAN)"
	default y

choice
	prompt "Choose HWF buffer size"
	default MEMBLOCK_QDMA_SIZE_4M
	depends on (MEMBLOCK_QDMA1 || MEMBLOCK_QDMA2)
	help
	  Number of entries in FoE Table

	config MEMBLOCK_QDMA_SIZE_4M
		bool "4MB"
	config MEMBLOCK_QDMA_SIZE_8M
		bool "8MB"
	config MEMBLOCK_QDMA_SIZE_16M
		bool "16MB"
endchoice

endif
```

## ndm/Kconfig.crypto
```kconfig
config  RALINK_HWCRYPTO
	tristate "HW Crypto Engine (EIP9x) support"
	depends on (RALINK_MT7621 || ECONET_EN75XX_MP || MACH_MT7623)
	default m

config RALINK_HWCRYPTO_ESP6
	bool "Offload ESP6 via Crypto Engine"
	depends on RALINK_HWCRYPTO
	depends on IPV6
	default n

config CRYPTO_DEV_MTK_AES
	tristate "MT7628 AES Engine support"
	depends on RALINK_MT7628
	default m

config CRYPTO_DEV_EIP93
	tristate "Support for EIP93 crypto HW accelerators"
	depends on (MACH_AN7552 || MACH_AN7581 || MACH_AN7583)
	help
	  EIP93 have various crypto HW accelerators. Select this if
	  you want to use the EIP93 modules for any of the crypto algorithms.

config CRYPTO_DEV_EIP93_DES
	bool "Register legacy DES / 3DES algorithm with the Crypto API"
	depends on CRYPTO_DEV_EIP93
	default n
	help
	  Selecting this will offload DES and 3DES ECB and CBC
	  crypto to the EIP-93 crypto engine.
```

## ndm/Kconfig.pon
```kconfig
config ANSOC_PON
	bool "Airoha SoC xPON support"
	depends on (MACH_AN7552 || MACH_AN7581 || MACH_AN7583)

if ANSOC_PON

config ANSOC_COMBO_PON
	bool "Support Combo-PON design"
	depends on MACH_AN7583
	default n

config LDDLA_EN7571
	bool "Support EN7571N laser diode driver"
	default y

config LDDLA_EN7572
	bool "Support EN7572A/EN7573A laser diode driver"
	depends on !MACH_AN7552
	default n

config LDDLA_AN8901
	bool "Support AN8901/2 (aka EN7572B/EN7573B) laser diode driver"
	depends on !MACH_AN7552
	default n

endif
```

## ndm/mt7993_ap/Kconfig
```kconfig
config MT7993_AP
	tristate "MT7993 802.11be AP support"
	select WIRELESS_EXT
	select WEXT_SPY
	select WEXT_PRIV

if MT7993_AP

config MT7993_WDS_SUPPORT
	bool "WDS support"
	default n

config MT7993_MBO_SUPPORT
	bool "MBO support"
	select MT7993_DOT11K_RRM_SUPPORT
	select MT7993_DOT11R_FT_SUPPORT
	select MT7993_DOT11V_WNM_SUPPORT
	select MT7993_DOT11U_GAS_SUPPORT
	default n

config MT7993_PASSPOINT_R2
	bool "Passpoint Release-2 support"
	default n

config MT7993_OCE_SUPPORT
	bool "Optimized Connectivity Experience support"
	depends on MT7993_MBO_SUPPORT
	default n

config MT7993_MAP_SUPPORT
	bool "Multi-AP Support"
	default y

config MT7993_WAPP_SUPPORT
	bool "MTK wapp daemon support"
	depends on MT7993_MAP_SUPPORT
	default n

config MT7993_QOS_R1_SUPPORT
	bool "MTK QoS R1 support"
	default n

config MT7993_BAND_STEERING
	bool "Band Steering support"
	default y

config MT7993_GREENAP_SUPPORT
	bool "GreenAP support"
	default n

config MT7993_AIR_MONITOR
	bool "Air Monitor"
	default n

config MT7993_CSI_SUPPORT
	bool "CSI support"
	default n

endif # MT7993_AP
```
