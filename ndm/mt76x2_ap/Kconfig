## ndm/mt76x2_ap/Kconfig
```kconfig
config MT76X2_AP
	tristate "MT7620/MT7602E/MT7612E AP Support"
	select WIRELESS_EXT
	select WEXT_SPY
	select WEXT_PRIV

if MT76X2_AP

config MBSS_SUPPORT
	bool "MBSSID Support"
	default y

config NEW_MBSSID_MODE
	bool "New MBSSID Mode"
	depends on MBSS_SUPPORT
	default y

config ENHANCE_NEW_MBSSID_MODE
	bool "Enhanced MBSSID Mode"
	depends on NEW_MBSSID_MODE
	default y

config WDS_SUPPORT
	bool "WDS Support"
	default n

config APCLI_SUPPORT
	bool "AP-Client Support"
	default y

config APCLI_CERT_SUPPORT
	bool "AP-Client TGn Cert Support"
	depends on APCLI_SUPPORT
	default n

config APCLI_AUTO_BW_SUPPORT
	bool "AP-Client Auto Bandwidth Support"
	depends on APCLI_SUPPORT
	default n

config MAC_REPEATER_SUPPORT
	bool "MAC Repeater Support"
	depends on APCLI_SUPPORT
	default n

config CON_WPS_SUPPORT
	bool "Concurrent WPS Support"
	depends on APCLI_SUPPORT
	depends on WSC_INCLUDED
	depends on WSC_V2_SUPPORT
	default n

config MWDS
	bool "Wireless Mixed Bridge Mode (MWDS) Support"
	select APCLI_SUPPORT
	default n

config SMART_MESH
	bool "Smart Mesh Support"
	select MWDS
	default n

config NINTENDO_AP
	bool "Nintendo AP"
	default n

config PASSPOINT_R2
	bool "Passpoint Release-2"
	select DOT11W_PMF_SUPPORT
	default n

config AIRPLAY_SUPPORT
	bool "AirPlay Support"
	default n

config BAND_STEERING
	bool "Band Steering"
	default n

config LLTD_SUPPORT
	bool "LLTD (Link Layer Topology Discovery Protocol) Support"
	default n

config IDS_SUPPORT
	bool "IDS (Intrusion Detection System) Support"
	default n

config COC_SUPPORT
	bool "GreenAP Support"
	default n

config DELAYED_TCP_ACK_SUPPORT
	bool "Delayed TCP ACK Support"
	default n

config IGMP_SNOOP_SUPPORT
	bool "IGMP Snooping Support"
	default y

#config MCAST_RATE_SPECIFIC
#	bool "User Specific Tx Rate of MCAST Packet"

endif # MT76X2_AP
```

## ndm/mt7915/Kconfig
```kconfig
if (MT7915_AP || MT7915_STA)

comment "MT7915 common settings"

config MT7915_DBDC_MODE
	bool "DBDC mode support"
	default y

config MT7915_MULTI_PROFILE_SUPPORT
	bool "Multi Profile Support"
	depends on MT7915_DBDC_MODE
	default n

config MT7915_DEFAULT_5G_PROFILE
	bool "5G default profile for DBDC"
	depends on MT7915_DBDC_MODE
	default n

config MT7915_LED_CONTROL_SUPPORT
	bool "LED support"
	default y

config MT7915_LED_PHR_CONTROL_SUPPORT
	bool "Soft-LED control support (NDM phr)"
	depends on MT7915_LED_CONTROL_SUPPORT
	default y

config MT7915_WSC_INCLUDED
	bool "WSC (WiFi Simple Config) support"
	default y

config MT7915_WSC_V2_SUPPORT
	bool "WSC V2 (WiFi Simple Config v2.0)"
	depends on MT7915_WSC_INCLUDED
	default y

config MT7915_DOT11_VHT_AC
	bool "802.11ac support"
	default y

config MT7915_DOT11_HE_AX
	bool "802.11ax support"
	depends on MT7915_DOT11_VHT_AC
	default y

config MT7915_G_BAND_256QAM_SUPPORT
	bool "2.4G 256QAM support"
	depends on MT7915_DOT11_VHT_AC
	default y

config MT7915_MUMIMO_SUPPORT
	bool "MU-MIMO support"
	default n

config MT7915_MU_RA_SUPPORT
	bool "MU-RGA support"
	depends on MT7915_MUMIMO_SUPPORT
	default n

config MT7915_DOT11W_PMF_SUPPORT
	bool "802.11w PMF (Protected Management Frames)"
	default y

config MT7915_DOT11R_FT_SUPPORT
	bool "802.11r Fast BSS Transition"
	default n

config MT7915_DOT11K_RRM_SUPPORT
	bool "802.11k Radio Resource Management"
	default n

config MT7915_DOT11V_WNM_SUPPORT
	bool "802.11v Wireless Network Management"
	default n

config MT7915_DOT11U_GAS_SUPPORT
	bool "802.11u Interworking/Gas Support"
	default n

config MT7915_TPC_SUPPORT
	bool "802.11h TPC support"
	default n

config MT7915_DFS_SUPPORT
	bool "802.11h DFS support"
	default n

config MT7915_BACKGROUND_SCAN_SUPPORT
	bool "Background Channels Scan support"
	default y

config MT7915_DEDICATED_RX_2G
	bool "Dedicated RX antenna for 2.4GHz"
	depends on MT7915_BACKGROUND_SCAN_SUPPORT

config MT7915_DEDICATED_RX_5G
	bool "Dedicated RX antenna for 5GHz"
	depends on MT7915_BACKGROUND_SCAN_SUPPORT
	default y

config MT7915_DEDICATED_RX_6G
	bool "Dedicated RX antenna for 6GHz"
	depends on MT7915_BACKGROUND_SCAN_SUPPORT

config MT7915_TXBF_SUPPORT
	bool "Tx Beam Forming support"
	default y

config MT7915_SMART_CARRIER_SENSE_SUPPORT
	bool "Smart Carrier Sense support"
	default y

config MT7915_TCP_RACK_SUPPORT
	bool "TCP Reduced ACK support"
	default n

config MT7915_SINGLE_SKU
	bool "Single SKU V2 support"
	default n

config MT7915_SNIFFER_SUPPORT
	bool "SNIFFER support"
	default n

#config MT7915_RF_LOCKDOWN_SUPPORT
#	bool "Single SKU RF lockdown support"
#	depends on MT7915_SINGLE_SKU
#	default n

config MT7915_WHNAT_SUPPORT
	tristate "Wifi Warp Hardware NAT support"
	depends on CHIP_MT7622 || ECONET_EN7528
	depends on CHIP_MT7915
	default m

config MT7915_PCIE_ASPM_DYM_CTRL_SUPPORT
	bool "PCIe ASPM Dynamic Control Support"
	depends on CHIP_MT7915
	default y

config MT7915_PCIE_MSI_SUPPORT
	bool "MSI interrupts support"
	depends on PCI_MSI
	depends on CHIP_MT7915
	default n

config MT7915_CFG80211_SUPPORT
	bool "CFG80211"
	default n

config MT7915_CUSTOMIZED_HOSTAPD
	bool "Customized Hostapd Support"
	depends on MT7915_CFG80211_SUPPORT
	default n

endif # (MT7915_AP || MT7915_STA)
```

## ndm/mt7915_ap/Kconfig
```kconfig
config MT7915_AP
	tristate "MT7915 802.11ax AP support"
	select WIRELESS_EXT
	select WEXT_SPY
	select WEXT_PRIV

if MT7915_AP

config MT7915_MBSS_SUPPORT
	bool "MBSSID support"
	default y

config MT7915_WDS_SUPPORT
	bool "WDS support"
	default n

config MT7915_APCLI_SUPPORT
	bool "AP-Client support"
	default y

config MT7915_APCLI_ROAM_SUPPORT
	bool "AP-Client Roam support"
	default y

config MT7915_APCLI_CERT_SUPPORT
	bool "AP-Client TGN Cert support"
	depends on MT7915_APCLI_SUPPORT
	default n

config MT7915_MAC_REPEATER_SUPPORT
	bool "MAC Repeater support"
	depends on MT7915_APCLI_SUPPORT
	default n

config MT7915_CON_WPS_SUPPORT
	bool "Concurrent WPS support"
	depends on MT7915_APCLI_SUPPORT
	depends on MT7915_WSC_INCLUDED
	depends on MT7915_WSC_V2_SUPPORT
	default n

config MT7915_PASSPOINT_R2
	bool "Passpoint Release-2 support"
	select MT7915_DOT11W_PMF_SUPPORT
	default n

#config MT7915_AIRPLAY_SUPPORT
#	bool "AirPlay support"
#	default n

config MT7915_FTM_SUPPORT
	bool "FTM support"
	select MT7915_PASSPOINT_R2
	default n

config MT7915_MBO_SUPPORT
	bool "MBO support"
	select MT7915_DOT11K_RRM_SUPPORT
	select MT7915_DOT11R_FT_SUPPORT
	select MT7915_DOT11V_WNM_SUPPORT
	select MT7915_DOT11U_GAS_SUPPORT
	default n

config MT7915_OCE_SUPPORT
	bool "Optimized Connectivity Experience support"
	default n

config MT7915_MAP_SUPPORT
	bool "Multi-AP Support"
	default y

config MT7915_WAPP_SUPPORT
	bool "MTK wapp daemon support"
	default n

config MT7915_VOW_SUPPORT
	bool "MediaAir (VOW) support"
	default y

config MT7915_RED_SUPPORT
	bool "RED (Random Early Drop) support"
	default y

config MT7915_WPA3_SUPPORT
	bool "WPA3 auth support"
	default y

config MT7915_OWE_SUPPORT
	bool "Enhanced OPEN (OWE) auth support"
	depends on MT7915_WPA3_SUPPORT
	default y

config MT7915_DSCP_PRI_SUPPORT
	bool "DSCP Priority Mapping support"
	default n

config MT7915_BAND_STEERING
	bool "Band Steering support"
	default n

#config MT7915_LLTD_SUPPORT
#	bool "LLTD (Link Layer Topology Discovery Protocol) support"
#	default n

#config MT7915_IDS_SUPPORT
#	bool "IDS (Intrusion Detection System) support"
#	default n

config MT7915_GREENAP_SUPPORT
	bool "GreenAP support"
	default n

config MT7915_TWT_SUPPORT
	bool "802.11ax Target Wake Time support"
	depends on MT7915_DOT11_HE_AX
	default y

config MT7915_IGMP_SNOOP_SUPPORT
	bool "IGMP Snooping support"
	default y

config MT7915_MCAST_RATE_SPECIFIC
	bool "User Specific Tx Rate of MCAST Packet"
	default n

config MT7915_RADIUS_ACCOUNTING_SUPPORT
	bool "Radius Accounting support"
	default n

config MT7915_ICAP_SUPPORT
	bool "Internal Capture support"
	default n

endif # MT7915_AP
```

## ndm/mt7916/Kconfig
```kconfig
if (MT7916_AP || MT7916_STA)

comment "MT7981/MT7986/MT7916 common settings"

config MT7916_DBDC_MODE
	bool "DBDC mode support"
	default y

config MT7916_MULTI_PROFILE_SUPPORT
	bool "Multi Profile Support"
	depends on MT7916_DBDC_MODE
	default n

config MT7916_DEFAULT_5G_PROFILE
	bool "5G default profile for DBDC"
	depends on MT7916_DBDC_MODE
	default y

config MT7916_6G_SUPPORT
	bool "6GHz support"
	default n

config MT7916_LED_CONTROL_SUPPORT
	bool "LED support"
	default y

config MT7916_LED_PHR_CONTROL_SUPPORT
	bool "Soft-LED control support (NDM phr)"
	depends on MT7916_LED_CONTROL_SUPPORT
	default y

config MT7916_WSC_INCLUDED
	bool "WSC (WiFi Simple Config) support"
	default y

config MT7916_WSC_V2_SUPPORT
	bool "WSC V2 (WiFi Simple Config v2.0)"
	depends on MT7916_WSC_INCLUDED
	default y

config MT7916_DOT11_VHT_AC
	bool "802.11ac support"
	default y

config MT7916_DOT11_HE_AX
	bool "802.11ax support"
	depends on MT7916_DOT11_VHT_AC
	default y

config MT7916_G_BAND_256QAM_SUPPORT
	bool "2.4G 256QAM support"
	depends on MT7916_DOT11_VHT_AC
	default y

config MT7916_MUMIMO_SUPPORT
	bool "MU-MIMO support"
	default y

config MT7916_MU_RA_SUPPORT
	bool "MU-RGA support"
	depends on MT7916_MUMIMO_SUPPORT
	default y

config MT7916_DOT11W_PMF_SUPPORT
	bool "802.11w PMF (Protected Management Frames)"
	default y

config MT7916_DOT11R_FT_SUPPORT
	bool "802.11r Fast BSS Transition"
	default y

config MT7916_DOT11K_RRM_SUPPORT
	bool "802.11k Radio Resource Management"
	default y

config MT7916_DOT11V_WNM_SUPPORT
	bool "802.11v Wireless Network Management"
	default y

config MT7916_DOT11U_GAS_SUPPORT
	bool "802.11u Interworking/Gas Support"
	default n

config MT7916_TPC_SUPPORT
	bool "802.11h TPC support"
	default n

config MT7916_DFS_SUPPORT
	bool "802.11h DFS support"
	default n

config MT7916_BACKGROUND_SCAN_SUPPORT
	bool "Background Channels Scan support"
	default n

config MT7916_TXBF_SUPPORT
	bool "Tx Beam Forming support"
	default y

config MT7916_SMART_CARRIER_SENSE_SUPPORT
	bool "Smart Carrier Sense support"
	default y

config MT7916_TCP_RACK_SUPPORT
	bool "TCP Reduced ACK support"
	default n

config MT7916_NETLINK_SUPPORT
	bool "Netlink communication support"
	default y

config MT7916_SINGLE_SKU
	bool "Single SKU V2 support"
	default y

config MT7916_SNIFFER_SUPPORT
	bool "SNIFFER support"
	default n

#config MT7916_RF_LOCKDOWN_SUPPORT
#	bool "Single SKU RF lockdown support"
#	depends on MT7916_SINGLE_SKU
#	default n

config MT7916_WHNAT_SUPPORT
	tristate "Wifi Warp Hardware NAT support"
	depends on MACH_EN7523 || MACH_MT7622 || MACH_MT7981 || MACH_MT7986
	default m

config MT7916_PCIE_ASPM_DYM_CTRL_SUPPORT
	bool "PCIe ASPM Dynamic Control Support"
	depends on CHIP_MT7916
	default n

config MT7916_PCIE_MSI_SUPPORT
	bool "MSI interrupts support"
	depends on PCI_MSI
	depends on CHIP_MT7916
	default n

config MT7916_CFG80211_SUPPORT
	bool "CFG80211"
	default n

config MT7916_CUSTOMIZED_HOSTAPD
	bool "Customized Hostapd Support"
	depends on MT7916_CFG80211_SUPPORT
	default n

endif # (MT7916_AP || MT7916_STA)
```

## ndm/mt7992/Kconfig
```kconfig
if (MT7992_AP || MT7992_STA)

comment "MT7992 common settings"

config MT7992_6G_SUPPORT
	bool "6GHz support"
	default n

config MT7992_LED_CONTROL_SUPPORT
	bool "LED support"
	default y

config MT7992_LED_PHR_CONTROL_SUPPORT
	bool "Soft-LED control support (NDM phr)"
	depends on MT7992_LED_CONTROL_SUPPORT
	default y

config MT7992_DOT11R_FT_SUPPORT
	bool "802.11r Fast BSS Transition"
	default y

config MT7992_DOT11K_RRM_SUPPORT
	bool "802.11k Radio Resource Management"
	default y

config MT7992_DOT11V_WNM_SUPPORT
	bool "802.11v Wireless Network Management"
	default y

config MT7992_DOT11U_GAS_SUPPORT
	bool "802.11u Interworking/Gas Support"
	default n

config MT7992_MT_DFS_SUPPORT
	bool "802.11h DFS support"
	default y

config MT7992_MT_BAND4_DFS_SUPPORT
	bool "802.11h DFS band4 (165..177) support"
	depends on MT7992_MT_DFS_SUPPORT
	default n

config MT7992_BACKGROUND_SCAN_SUPPORT
	bool "Background Channels Scan support"
	default n

config MT7992_RF_LOCKDOWN_SUPPORT
	bool "Single SKU RF lockdown support"
	default n

config MT7992_SNIFFER_SUPPORT
	bool "SNIFFER support"
	default n

config MT7992_SNIFFER_RADIOTAP_SUPPORT
	bool "Sniffer radiotap support"
	default n

config MT7992_CFG80211_SUPPORT
	bool "CFG80211"
	default n

config MT7992_CUSTOMISED_HOSTAPD_SUPPORT
	bool "Customized Hostapd Support"
	depends on MT7992_CFG80211_SUPPORT
	default n

endif # (MT7992_AP || MT7992_STA)
```

## ndm/mt7992_ap/Kconfig
```kconfig
config MT7992_AP
	tristate "MT7992 802.11be AP support"
	select WIRELESS_EXT
	select WEXT_SPY
	select WEXT_PRIV

if MT7992_AP

config MT7992_WDS_SUPPORT
	bool "WDS support"
	default n

config MT7992_MBO_SUPPORT
	bool "MBO support"
	select MT7992_DOT11K_RRM_SUPPORT
	select MT7992_DOT11R_FT_SUPPORT
	select MT7992_DOT11V_WNM_SUPPORT
	select MT7992_DOT11U_GAS_SUPPORT
	default n

config MT7992_PASSPOINT_R2
	bool "Passpoint Release-2 support"
	default n

config MT7992_OCE_SUPPORT
	bool "Optimized Connectivity Experience support"
	depends on MT7992_MBO_SUPPORT
	default n

config MT7992_MAP_SUPPORT
	bool "Multi-AP Support"
	default y

config MT7992_WAPP_SUPPORT
	bool "MTK wapp daemon support"
	depends on MT7992_MAP_SUPPORT
	default n

config MT7992_QOS_R1_SUPPORT
	bool "MTK QoS R1 support"
	default n

config MT7992_BAND_STEERING
	bool "Band Steering support"
	default y

config MT7992_GREENAP_SUPPORT
	bool "GreenAP support"
	default n

config MT7992_AIR_MONITOR
	bool "Air Monitor"
	default n

config MT7992_CSI_SUPPORT
	bool "CSI support"
	default n

endif # MT7992_AP
```
